## Kconfig
```kconfig
menu "Micro ROS Zephyr Demo"

config MICROROS_AGENT_IP
	string "micro-ROS Agent IP"
	help
	  micro-ROS Agent IP.

config MICROROS_AGENT_PORT
	string "micro-ROS Agent Port"
	default "8888"
	help
	  micro-ROS Agent port.

endmenu

source "Kconfig.zephyr"
```

## west.yml
```yaml
manifest:

  projects:
    - name: zephyr
      url: https://github.com/zephyrproject-rtos/zephyr
      revision: main
      west-commands: scripts/west-commands.yml
      import:
        name-allowlist:
          - cmsis
          - hal_stm32
          - picolibc

    - name: libros2-zephyr
      url: https://github.com/yashi/libros2-zephyr
      revision: main
      import:
        path-prefix: modules/ros2
```
